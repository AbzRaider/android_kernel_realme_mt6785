/*
 * Generated by MTK SP DrvGen Version: 3.5.160809 for MT6785.
 * 2024-09-29 07:04:17
 * Do Not Modify The File.
 * Copyright Mediatek Inc. (c) 2016.
*/

/*************************
 * CLK_BUF DTSI File
*************************/

&pmic_clock_buffer_ctrl {
	mediatek,clkbuf-quantity = <7>;
	mediatek,clkbuf-config = <2 1 1 2 0 0 1>;
	mediatek,clkbuf-output-impedance = <4 4 4 4 0 0 4>;
	mediatek,clkbuf-controls-for-desense = <0 4 0 3 0 0 0>;
	status = "okay";
};
