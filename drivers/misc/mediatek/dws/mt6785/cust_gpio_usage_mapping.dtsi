/*
 * Generated by MTK SP DrvGen Version: 3.5.160809 for MT6785.
 * 2024-09-29 07:04:17
 * Do Not Modify The File.
 * Copyright Mediatek Inc. (c) 2016.
*/

&gpio_usage_mapping {
	GPIO_FDD_BAND_SUPPORT_DETECT_4TH_PIN = <&pio 73 0>;
	GPIO_FDD_BAND_SUPPORT_DETECT_3RD_PIN = <&pio 74 0>;
	GPIO_FDD_BAND_SUPPORT_DETECT_1ST_PIN = <&pio 87 0>;
	GPIO_FDD_BAND_SUPPORT_DETECT_2ND_PIN = <&pio 88 0>;
	GPIO_SIM1_SIO = <&pio 128 0>;
	GPIO_SIM1_SRST = <&pio 129 0>;
	GPIO_SIM1_SCLK = <&pio 130 0>;
	GPIO_SIM2_SCLK = <&pio 131 0>;
	GPIO_SIM2_SRST = <&pio 132 0>;
	GPIO_SIM2_SIO = <&pio 133 0>;
	GPIO_SIM1_HOT_PLUG = <&pio 140 0>;
	GPIO_SIM2_HOT_PLUG = <&pio 141 0>;
};
